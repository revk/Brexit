## main/Kconfig
```kconfig
menu "Brexit"

	config BREXIT_DEADLINE
	string "Deadline"
	default "2020-01-31 23:00:00"
	help
		The deadline

	config BREXIT_TAGLINE
	string "Tag line"
	default "DOOMSDAY COMETH"
	help
		The tag line before clock set


endmenu
```
